## conf/layer.conf
```bitbake
# We have a conf and classes directory, add to BBPATH
BBPATH .= ":${LAYERDIR}"

# We have recipes-* directories, add to BBFILES
BBFILES += "${LAYERDIR}/recipes-*/*/*.bb \
            ${LAYERDIR}/recipes-*/*/*.bbappend \
            ${LAYERDIR}/recipes-*/*/*/*.bb \
            ${LAYERDIR}/recipes-*/*/*/*.bbappend"

BBFILE_COLLECTIONS += "orion"
BBFILE_PATTERN_orion = "^${LAYERDIR}/"
BBFILE_PRIORITY_orion = "10"

LAYERDEPENDS_orion = "core openembedded-layer meta-python networking-layer wayland qt6-layer raspberrypi"
LAYERSERIES_COMPAT_orion = "kirkstone"
LAYERVERSION_orion = "1"
```
